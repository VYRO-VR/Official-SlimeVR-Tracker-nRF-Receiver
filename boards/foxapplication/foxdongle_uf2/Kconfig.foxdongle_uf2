## boards/foxapplication/foxdongle_uf2/Kconfig.foxdongle_uf2
```kconfig
# Copyright (c) 2024 Nordic Semiconductor ASA
# SPDX-License-Identifier: Apache-2.0

config BOARD_FOXDONGLE_UF2
	select SOC_NRF52840_QIAA

if BOARD_FOXDONGLE_UF2

config BOARD_SERIAL_BACKEND_CDC_ACM
	bool "USB CDC"
	default y

config MPSL_FEM_GENERIC_TWO_CTRL_PINS_SUPPORT
	bool "Use FEM"
	default y
	help
	  Use the RF front-end module (FEM) to amplify the RF signal, increasing
	  the range, strength and robustness of the link.

config BOARD_ENABLE_FEM
	bool "FEM enabled"
	default y
	select MPSL_FEM_GENERIC_TWO_CTRL_PINS_SUPPORT
	help
	  Enable front-end module (FEM).

endif # BOARD_FOXDONGLE_UF2
```
